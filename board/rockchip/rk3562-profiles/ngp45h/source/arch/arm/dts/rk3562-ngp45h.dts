// SPDX-License-Identifier: GPL-2.0+
/dts-v1/;
#include "rk3562-ngp45h-vendor.dtsi"
#include "rk3562-profile-u-boot.dtsi"

/* Boot storage follows this board's original U-Boot, not its Linux DTB. */
#include "rk3562-ngp45h-mmc.dtsi"
