// SPDX-License-Identifier: GPL-2.0+
/dts-v1/;
#include "rk3562-pocket-ais-vendor.dtsi"
#include "rk3562-profile-u-boot.dtsi"

/* Boot storage follows this board's original U-Boot, not its Linux DTB. */
#include "rk3562-pocket-ais-mmc.dtsi"
